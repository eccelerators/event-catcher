# EventCatcherIfc: IP-XACT component
VLNV eccelerators.com:interface:EventCatcherIfc:0.0.1

## Address spaces and blocks
EventCatcherBlk.EventMaskReg: base 0, range 4, width 8
EventCatcherBlk.EventCatchReg: base 4, range 4, width 8
EventCatcherBlk.EventOverrunReg: base 8, range 4, width 8

## Registers
Registers are 32-bit, read-write, reset 0x0 unless marked. A register's access mark holds for its fields unless they carry their own. Offsets are from the block's base; lines under a group give offsets from that group; [hi:lo] are bit positions; {n}, {i} and the like mark numbered series; 'fields as' and 'values as' point back to an identical list; <NAME> marks a mode.

## EventCatcherBlk.EventMaskReg
Base 0x00000000
0x00 EventMaskReg reset not defined — Event Mask Register
  [3:0] Mask
    1=EventEnabled (Event is catched and forwarded.); 0=EventDisabled (Event is ignored.)

## EventCatcherBlk.EventCatchReg
Base 0x00000004
0x04 EventCatchReg — Event Catch Register
  [3:0] Catch
    1=Catched (An event has been catched and is waiting to be processed.); 0=NotCatched (No event has been catched.); 1=Catch_Confirmed (SW writes Confirmed to confirm to HW that a catched event has been processed. The value isn't stored, thus there is no need to reset it to '0' again. Solely the write action is sufficient.); 0=Catch_InEffective

## EventCatcherBlk.EventOverrunReg
Base 0x00000008
0x08 EventOverrunReg — Event Overrun Register
  [3:0] Overrun
    1=Happened (There has been a new event before a catched event had been processed thus an overrun has happened and at least one event has been lost.); 0=NotHappened (No event has been lost.); 1=Overrun_Confirmed (SW writes Confirmed to confirm to HW that a event overrun has been processed. The value isn't stored, thus there is no need to reset it to '0' again. Solely the write action is sufficient.); 0=Overrun_InEffective
